## kernel_device_modules-6.12/drivers/input/fingerprint/Kconfig
```kconfig
# SPDX-License-Identifier: GPL-2.0-only

menu "Fingerprint support"

source "$(KCONFIG_EXT_PREFIX)drivers/input/fingerprint/goodix_cap/Kconfig"

endmenu
```

## kernel_device_modules-6.12/drivers/input/fingerprint/goodix_cap/Kconfig
```kconfig
# SPDX-License-Identifier: GPL-2.0-only

config GOODIX_CAP_FINGERPRINT
	tristate "Goodix GF3626ZS9 SPI Fingerprint Sensor Driver"
	depends on SPI
	help
	  This enables support for Goodix GF3626ZS9 SPI fingerprint sensor.
	  Say M here if you want to build it as a module.
```
